/ {
	chosen {
		zephyr,display = &oled;
	};
};

&i2c0 {
	compatible = "nordic,nrf-twi";
	sda-pin = <6>;
	scl-pin = <26>;
	status = "okay";

	oled: ssd1306@3c {
		compatible = "solomon,ssd1306fb";
		reg = <0x3c>;
		label = "SSD1306";
		width = <128>;
		height = <32>;
		segment-offset = <0>;
		page-offset = <0>;
		display-offset = <0>;
		multiplex-ratio = <31>;
		segment-remap;
		com-invdir;
		com-sequential;
		prechargep = <0x22>;
	};
};
